/**
 *********************************************************************
 * @file    device_oled.c
 * @brief   0.96 寸 OLED (SSD1306) 设备驱动实现
 * @note    使用 HAL I2C 接口，通过 0x00/0x40 前缀区分命令和数据
 *          6x8 ASCII 字模
 *********************************************************************
 */
#include "device_oled.h"
#include "main.h"   /* 包含 hi2c1 声明 */
#include <string.h>

/* 外部 I2C 句柄（CubeMX 生成） */
extern I2C_HandleTypeDef hi2c1;

/* ============================================================
 * 6x8 ASCII 字模（32~127 共 96 个字符）
 * ============================================================ */
static const uint8_t oled_font6x8[][6] = {
    {0x00,0x00,0x00,0x00,0x00,0x00}, {0x00,0x00,0x5F,0x00,0x00,0x00},
    {0x00,0x07,0x00,0x07,0x00,0x00}, {0x14,0x7F,0x14,0x7F,0x14,0x00},
    {0x24,0x2A,0x7F,0x2A,0x12,0x00}, {0x23,0x13,0x08,0x64,0x62,0x00},
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    {0x08,0x08,0x2A,0x1C,0x08,0x00},
};

/* ============================================================
 * 底层 I2C 写命令 / 写数据
 * ============================================================ */

static void oled_write_cmd(uint8_t cmd)
{
    uint8_t buf[2] = {0x00, cmd};
    HAL_I2C_Master_Transmit(&hi2c1, OLED_I2C_ADDR, buf, 2, 100);
}

static void oled_write_data(uint8_t data)
{
    uint8_t buf[2] = {0x40, data};
    HAL_I2C_Master_Transmit(&hi2c1, OLED_I2C_ADDR, buf, 2, 100);
}

/* ============================================================
 * 公共接口（Device_OLED_ 前缀）
 * ============================================================ */

/**
 * @brief  测试 OLED 是否连接（通过 I2C 探测地址）
 */
uint8_t Device_OLED_TestConnection(void)
{
    HAL_StatusTypeDef status;
    status = HAL_I2C_IsDeviceReady(&hi2c1, OLED_I2C_ADDR, 1, 100);
    return (status == HAL_OK) ? 1 : 0;
}

/**
 * @brief  OLED 初始化
 */
void Device_OLED_Init(void)
{
    HAL_Delay(100);

    oled_write_cmd(0xAE);  /* 关闭显示 */
    oled_write_cmd(0x20);  /* 内存地址模式 */
    oled_write_cmd(0x02);  /* 页地址模式（0x02 = Page Addressing Mode） */
    oled_write_cmd(0xB0);  /* 页起始地址 0 */
    oled_write_cmd(0xC8);  /* COM 扫描方向 */
    oled_write_cmd(0x00);  /* 低位列地址 */
    oled_write_cmd(0x10);  /* 高位列地址 */
    oled_write_cmd(0x40);  /* 起始行地址 */
    oled_write_cmd(0x81);  /* 对比度 */
    oled_write_cmd(0xFF);
    oled_write_cmd(0xA1);  /* SEG 重映射 */
    oled_write_cmd(0xA6);  /* 正常显示 */
    oled_write_cmd(0xA8);  /* 多路复用率 */
    oled_write_cmd(0x3F);  /* 1/64 */
    oled_write_cmd(0xA4);  /* 全局显示开启 */
    oled_write_cmd(0xD3);  /* 显示偏移 */
    oled_write_cmd(0x00);
    oled_write_cmd(0xD5);  /* 时钟分频 */
    oled_write_cmd(0xF0);
    oled_write_cmd(0xD9);  /* 预充电周期 */
    oled_write_cmd(0x22);
    oled_write_cmd(0xDA);  /* COM 引脚配置 */
    oled_write_cmd(0x12);
    oled_write_cmd(0xDB);  /* VCOMH 电压 */
    oled_write_cmd(0x20);
    oled_write_cmd(0x8D);  /* 电荷泵 */
    oled_write_cmd(0x14);
    oled_write_cmd(0xAF);  /* 开启显示 */

    Device_OLED_Clear();
}

/**
 * @brief  清屏
 */
void Device_OLED_Clear(void)
{
    uint8_t page, col;
    for (page = 0; page < OLED_PAGES; page++) {
        Device_OLED_SetPos(page, 0);
        for (col = 0; col < OLED_WIDTH; col++) {
            oled_write_data(0x00);
        }
    }
}

/**
 * @brief  设置光标位置
 */
void Device_OLED_SetPos(uint8_t page, uint8_t col)
{
    oled_write_cmd(0xB0 + (page & 0x07));
    oled_write_cmd(0x10 + ((col >> 4) & 0x0F));
    oled_write_cmd(0x00 + (col & 0x0F));
}

/**
 * @brief  显示一个 6x8 ASCII 字符
 */
void Device_OLED_ShowChar(uint8_t page, uint8_t col, char ch)
{
    uint8_t i, index;

    if (ch < 32 || ch > 127) ch = ' ';
    index = ch - 32;

    Device_OLED_SetPos(page, col);
    for (i = 0; i < 6; i++) {
        oled_write_data(oled_font6x8[index][i]);
    }
}

/**
 * @brief  显示字符串
 */
void Device_OLED_ShowString(uint8_t page, uint8_t col, const char *str)
{
    while (*str && col < OLED_WIDTH) {
        Device_OLED_ShowChar(page, col, *str);
        col += 6;
        str++;
    }
}

/**
 * @brief  显示数字（补零）
 */
void Device_OLED_ShowNum(uint8_t page, uint8_t col, uint32_t num, uint8_t len)
{
    char buf[11];
    uint8_t i;
    if (len > 10) len = 10;
    for (i = 0; i < len; i++) {
        buf[len - 1 - i] = '0' + (num % 10);
        num /= 10;
    }
    buf[len] = '\0';
    Device_OLED_ShowString(page, col, buf);
}

/**
 * @brief  刷新（直接写屏模式下为空函数，留作兼容）
 */
void Device_OLED_Refresh(void)
{
    /* 直接写屏模式无需操作 */
}
